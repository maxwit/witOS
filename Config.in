## Config.in
```kconfig
mainmenu "WitOS Configuration"

menu "Processor type and features"
source "arch/Config.in"
endmenu

menu "Device Drivers"
source "driver/Config.in"
endmenu

menu "File systems"
source "fs/Config.in"
endmenu

menu "System libs"
source "lib/Config.in"
endmenu

menu "System commands"
source "shell/Config.in"
endmenu
```

## arch/arm/Config.in
```kconfig
config CONFIG_ARCH
	string
	default "arm"

config CONFIG_ARM
	bool
	default y

config CONFIG_CROSS_COMPILE
	string "cross compile"
	default "arm-none-eabi-"

config CONFIG_ARCH_VER
	string 
	default "armv6k" if CONFIG_ARMV6K
	default "armv5te" if CONFIG_ARMV5TE

choice
	prompt "arm version"
	default CONFIG_ARMV6K

config CONFIG_ARMV5TE
	bool "armv6k"

config CONFIG_ARMV6K
	bool "armv5te"
endchoice


config CONFIG_IRQ_SUPPORT
	bool "irq support"


config CONFIG_START_MEM
	int
	default 0x33F80000 if CONFIG_S3C2410
	default 0x53000000 if CONFIG_S3C6410

choice
	prompt "ARCH SoC"
	default CONFIG_S3C6410

config CONFIG_S3C2410
	bool "S3C2410 SOC"

config CONFIG_S3C6410
	bool "S3C6410 SOC"
endchoice


choice
	prompt "Board"
	default CONFIG_BOARD_MW61

config CONFIG_BOARD_MW61
	bool "S3C2410 board"

config CONFIG_BOARD_MW71 
	bool "S3C6410 board"

config CONFIG_BOARD_DEVKIT8000
	bool "devkit8000 board"

config CONFIG_BOARD_MINI6410
	bool "mini6410 board"

config CONFIG_BOARD_EVM3530
	bool "evm3530 board"

config CONFIG_BOARD_BEAGLE
	bool "beagle board"
endchoice
```

## build/configs/arm/at91sam9261_defconfig
```kconfig
#AT91SAM9261 Platform Configuration

CONFIG_AT91SAM9261=y
CONFIG_ARCH=arm
CONFIG_ARCH_VER=armv5te
CONFIG_IRQ_SUPPORT=y

CONFIG_CROSS_COMPILE=arm-maxwit-linux-gnueabi-

CONFIG_LOADER_MENU=y
CONFIG_DEFAULT_LOADER=LM_NAND

CONFIG_GTH_START_MEM=0x00300000
CONFIG_GBH_START_MEM=0x23F00000
CONFIG_GBH_NAND_START = 0

CONFIG_FLASH=y
CONFIG_NAND=y
CONFIG_NAND_AT91=y

# MMC/SD
CONFIG_MMC=y
CONFIG_MMC_AT91=y

# UART
CONFIG_UART=y
CONFIG_UART_AT91=y
CONFIG_UART_INDEX=0
CONFIG_YMODEM_SUPPORT=y
CONFIG_KERMIT_SUPPORT=y

# Graphics
CONFIG_DISPLAY=y
CONFIG_DISPLAY_AT91=y
CONFIG_LCD_ID=1
CONFIG_BOOTUP_LOGO=y

# Networking
CONFIG_NET=y
CONFIG_DM9000=y

# OS Booting

#File systems
CONFIG_FS = y
```

## build/configs/arm/at91sam9263_defconfig
```kconfig
CONFIG_AT91SAM9263 = y
CONFIG_ARCH = arm
CONFIG_ARCH_VER = armv5te
CONFIG_IRQ_SUPPORT = y
CONFIG_CROSS_COMPILE = arm-none-eabi-
CONFIG_START_MEM = 0x23F00000
CONFIG_FLASH = y
CONFIG_NAND = y
CONFIG_NAND_AT91 = y
CONFIG_MMC = y
CONFIG_MMC_AT91 = y
CONFIG_UART = y
CONFIG_UART_AT91 = y
CONFIG_UART_INDEX = 0
CONFIG_YMODEM_SUPPORT = y
CONFIG_KERMIT_SUPPORT = y
CONFIG_DISPLAY = y
CONFIG_NET = y
CONFIG_AT91_EMAC = y
CONFIG_FS = y
```

## build/configs/arm/beagle_defconfig
```kconfig
CONFIG_OMAP3 = y
CONFIG_BOARD_BEAGLE = y
CONFIG_ARCH = arm
CONFIG_ARCH_VER = armv7-a
CONFIG_START_MEM = 0x83002000
CONFIG_CROSS_COMPILE = arm-none-eabi-
CONFIG_MMC = y
CONFIG_MMC_OMAP3 = y
CONFIG_FLASH = y
CONFIG_NAND = y
CONFIG_NAND_OMAP3 = y
CONFIG_FS = y
CONFIG_EXT2 = y
CONFIG_EXT3 = y
CONFIG_EXT4 = y
CONFIG_UART_OMAP3 = y
CONFIG_UART_INDEX = 2
CONFIG_YMODEM_SUPPORT = y
CONFIG_KERMIT_SUPPORT = y
CONFIG_DISPLAY = y
CONFIG_NET = y
CONFIG_SMSC91X = y
```

## build/configs/arm/devkit8000_defconfig
```kconfig
# OMAP3 Platform Configuration

# General
CONFIG_OMAP3=y
CONFIG_BOARD_DEVKIT8000=y
CONFIG_ARCH=arm
# CONFIG_ARCH_VER=armv6k
CONFIG_ARCH_VER=armv7-a
# CONFIG_IRQ_SUPPORT=y
CONFIG_CROSS_COMPILE=arm-linux-
CONFIG_START_MEM=0x83002000
CONFIG_DEBUG=y

# MMC/SD
CONFIG_MMC=y
CONFIG_MMC_OMAP3=y

# Flash
CONFIG_FLASH=y
CONFIG_NAND=y
CONFIG_NAND_OMAP3=y
#CONFIG_NOR=y

#File systems
CONFIG_FS=y
CONFIG_EXT2=y
CONFIG_EXT3=y
CONFIG_EXT4=y

# UART
CONFIG_UART_OMAP3=y
CONFIG_UART_INDEX=2
CONFIG_YMODEM_SUPPORT=y
CONFIG_KERMIT_SUPPORT=y

# SPI
#CONFIG_SPI=y
#CONFIG_SPI_OMAP3=y

# Graphics
CONFIG_DISPLAY=y
CONFIG_DISPLAY_OMAP3=y
#CONFIG_BOOTUP_LOGO=y

# Networking
CONFIG_NET=y
CONFIG_DM9000=y

# OS Booting
```

## build/configs/arm/evm3530_defconfig
```kconfig
CONFIG_OMAP3 = y
CONFIG_BOARD_EVM3530 = y
CONFIG_ARCH = arm
CONFIG_ARCH_VER = armv7-a
CONFIG_IRQ_SUPPORT = y
CONFIG_CROSS_COMPILE = arm-none-eabi-
CONFIG_START_MEM = 0x83002000
CONFIG_MMC = y
CONFIG_MMC_OMAP3 = y
CONFIG_FLASH = y
CONFIG_NAND = y
CONFIG_NAND_OMAP3 = y
CONFIG_UART_OMAP3 = y
CONFIG_UART_INDEX = 0
CONFIG_YMODEM_SUPPORT = y
CONFIG_KERMIT_SUPPORT = y
CONFIG_DISPLAY = y
CONFIG_NET = y
CONFIG_FS = y
CONFIG_EXT2 = y
CONFIG_EXT3 = y
CONFIG_EXT4 = y
CONFIG_DEBUG = y
```

## build/configs/arm/mw71_defconfig
```kconfig
# OMAP3530 Platform Configuration

CONFIG_OMAP3530=y
CONFIG_BOARD_EVM3530=y
CONFIG_ARCH=arm
# CONFIG_ARCH_VER=armv6k
CONFIG_ARCH_VER=armv7-a
# CONFIG_IRQ_SUPPORT=y

CONFIG_CROSS_COMPILE=arm-maxwit-linux-gnueabi-

CONFIG_LOADER_MENU=y
CONFIG_DEFAULT_LOADER=LM_NAND
CONFIG_GTH_WRITE=y

# CONFIG_GTH_START_MEM=0x40200800
CONFIG_GTH_START_MEM=0x402007F8
CONFIG_GBH_START_MEM=0x82000000
CONFIG_GBH_START_BLK=4

# MMC/SD
CONFIG_MMC=y
CONFIG_MMC_OMAP3=y

# Flash
CONFIG_FLASH=y
CONFIG_NAND=y
CONFIG_NAND_OMAP3=y
CONFIG_NAND_ECC_MODE=NAND_ECC_HW
#CONFIG_NOR=y
CONFIG_NAND_16BIT=y

# UART
CONFIG_UART_OMAP3=y
CONFIG_UART_INDEX=0
CONFIG_YMODEM_SUPPORT=y
CONFIG_KERMIT_SUPPORT=y
CONFIG_CONSOLE_NAME="ttyO"

# SPI
#CONFIG_SPI=y
#CONFIG_SPI_OMAP3=y

# Graphics
#CONFIG_GRAPHICS=y
#CONFIG_GRAPHICS_OMAP3=y
#CONFIG_LCD_MODEL="?"
#CONFIG_BOOTUP_LOGO=y

# Networking
CONFIG_NET=y
CONFIG_LAN9220=y

# OS Booting
CONFIG_MACH_TYPE=1535
```

## build/configs/arm/s3c2410_defconfig
```kconfig
# S3C2410

CONFIG_S3C2410 = y
CONFIG_ARCH = arm
CONFIG_ARCH_VER = armv4t
CONFIG_PLAT_DIR = s3c24x0
CONFIG_PLAT_OPT = -DCONFIG_S3C2410
CONFIG_CROSS_COMPILE = arm-maxwit-linux-gnueabi-
CONFIG_IRQ_SUPPORT = y

# TH
CONFIG_LOADER_MENU = y
CONFIG_DEFAULT_LOADER = LM_NAND

CONFIG_GTH_START_MEM = 0x00000000
CONFIG_GBH_START_MEM = 0x33F80000
CONFIG_GBH_NAND_START = 0x20000

# Graphics
CONFIG_DISPLAY = y
CONFIG_DISPLAY_S3C24X = y

# UART
CONFIG_UART = y
CONFIG_UART_S3C24X = y
CONFIG_UART_INDEX = 0
CONFIG_YMODEM_SUPPORT = y
# CONFIG_KERMIT_SUPPORT = y

# Flash
CONFIG_FLASH = y
CONFIG_NAND = y
CONFIG_NAND_S3C24X = y

# Networking
CONFIG_NET = y
CONFIG_DM9000 = y
# CONFIG_CS8900 = y

# OS Booting

#File systems
CONFIG_FS = y
```

## build/configs/arm/s3c2440_defconfig
```kconfig
# S3C2440

CONFIG_LOADER_MENU = y
CONFIG_GTH_WRITE = y

CONFIG_GTH_START_MEM = 0x00000000
CONFIG_GBH_START_MEM = 0x33F80000
CONFIG_GBH_START_BLK = 1
CONFIG_GTH_WRITE = y

CONFIG_UART = y
CONFIG_UART_INDEX = 0

CONFIG_DM9000 = y
CONFIG_MAC_ADDR = {0x10,0x20,0x30,0x40,0x50,0x60}
CONFIG_LOCAL_IP = MKIP(192,168,2,100)
CONFIG_SERVER_IP = MKIP(192,168,2,101)
CONFIG_NET_MASK = MKIP(255,255,255,0)

CONFIG_S3C2440 = y
CONFIG_IRQ_SUPPORT = y
CONFIG_NAND = y
CONFIG_NAND_S3C = y
CONFIG_NAND_ECC_MODE = NAND_ECC_HW
CONFIG_YMODEM_SUPPORT = y
# CONFIG_KERMIT_SUPPORT = y

CONFIG_ARCH = arm
CONFIG_ARCH_VER = armv4t
CONFIG_PLAT_DIR = s3c24x0
CONFIG_PLAT_OPT = -DCONFIG_S3C2440
CONFIG_CROSS_COMPILE = arm-maxwit-linux-gnueabi-

CONFIG_GPU = y
CONFIG_LCD_ID = 0
CONFIG_BOOTUP_LOGO = y

CONFIG_IMAGE_PATH = "/var/lib/tftpboot"
CONFIG_CONSOLE_NAME = "ttySAC"
```

## build/configs/arm/s3c6410_defconfig
```kconfig
# S3C6410 Platform Configuration

CONFIG_S3C6410 = y
CONFIG_BOARD_MW61 = y
CONFIG_ARCH = arm
CONFIG_ARCH_VER = armv6k
CONFIG_IRQ_SUPPORT = y
# CONFIG_TIMER_SUPPORT = y

CONFIG_CROSS_COMPILE = arm-maxwit-linux-gnueabi-

CONFIG_LOADER_MENU = y
CONFIG_DEFAULT_LOADER = LM_NAND

CONFIG_GTH_START_MEM = 0x0C000000
CONFIG_GBH_START_MEM = 0x53000000
CONFIG_GBH_NAND_START = 0x20000

# Flash
CONFIG_FLASH = y
CONFIG_NAND = y
CONFIG_NAND_S3C24X = y
CONFIG_NOR = y

# UART
CONFIG_UART = y
CONFIG_UART_S3C64X = y
CONFIG_UART_INDEX = 0
CONFIG_YMODEM_SUPPORT = y
CONFIG_KERMIT_SUPPORT = y

# MMC/SD
CONFIG_MMC = y
CONFIG_MMC_S3C64X = y

# SPI
CONFIG_SPI = y
CONFIG_SPI_S3C64X = y

# Graphics
CONFIG_DISPLAY = y
CONFIG_DISPLAY_S3C64X = y
# CONFIG_BOOTUP_LOGO = y

# Networking
CONFIG_NET = y
CONFIG_DM9000 = y

# OS Booting

#File systems
CONFIG_FS = y
```

## driver/Config.in
```kconfig
config CONFIG_FLASH
	prompt "flash"
	bool
	default y

config CONFIG_NAND
	prompt "NAND flash"
	bool
	default y
	depends on CONFIG_FLASH

config CONFIG_NAND_S3C24X
	prompt "S3C24X NAND flash"
	bool
	default y
	depends on CONFIG_FLASH

config CONFIG_NOR
	prompt "Nor flash"
	bool
	default y
	depends on CONFIG_FLASH

config CONFIG_UART
	prompt "uart"
	bool
	default y

config CONFIG_UART_INDEX
	prompt "uart index"
	int
	default 0
	depends on CONFIG_UART

choice
	prompt "uart soc"
	default CONFIG_UART_S3C64X
	depends on CONFIG_UART

config CONFIG_UART_S3C64X
	prompt "uart s3c64x"
	bool

config CONFIG_UART_S3C24X
	prompt "uart s3c24x"
	bool

config CONFIG_UART_OMAP3
	prompt "uart omap3"
	bool

config CONFIG_UART_AT91
	prompt "uart at91"
	bool
endchoice

config CONFIG_KERMIT_SUPPORT
	prompt "kermit support"
	bool
	depends on CONFIG_UART

config CONFIG_YMODEM_SUPPORT
	prompt "ymodem support"
	bool
	depends on CONFIG_UART

config CONFIG_DISPLAY
	prompt "display"
	bool
	default y

config CONFIG_DISPLAY_S3C64X
	bool "s3c64x display"
	depends on CONFIG_DISPLAY

config CONFIG_DISPLAY_S3C24X
	bool "s3c24x display"
	depends on CONFIG_DISPLAY

config CONFIG_DISPLAY_OMAP3
	bool "omap3 display"
	depends on CONFIG_DISPLAY

config CONFIG_DISPLAY_AT91
	bool "at91 display"
	depends on CONFIG_DISPLAY

config CONFIG_MMC
	prompt "mmc"
	bool
	default y

config CONFIG_MMC_S3C64X
	prompt "s3c64x mmc"
	bool
	default y
	depends on CONFIG_MMC

config CONFIG_SPI
	prompt "spi"
	bool
	default y

config CONFIG_SPI_S3C64X
	prompt "s3c64x spi"
	bool
	default y
	depends on CONFIG_SPI

config CONFIG_NET
	prompt "net"
	bool
	default y

config CONFIG_DM9000
	prompt "dm9000"
	bool
	default y
	depends on CONFIG_NET
```

## fs/Config.in
```kconfig
config CONFIG_FS
	bool
	default y

config CONFIG_EXT2
	bool "EXT2 filesystem"

config CONFIG_EXT3
	bool "EXT3 filesystem"

config CONFIG_EXT4
	bool "EXT4 filesystem"
```

## lib/Config.in
```kconfig
config CONFIG_LIB
	bool
	default y

config CONFIG_LIB_DISPLAY
	bool "display lib"

config CONFIG_LIB_FLASH
	bool "flash lib"

config CONFIG_LIB_FS
	bool "filesystem lib"

config CONFIG_LIB_LINUX
	bool "linux lib"

config CONFIG_LIB_NET
	bool "net lib"

config CONFIG_LIB_STD
	bool "std lib"

config CONFIG_LIB_UART
	bool "uart lib"

config CONFIG_LIB_UNISTD
	bool "unistd lib"

config CONFIG_LIB_EXTRA
	bool "extra lib"
```

## wish/Config.in
```kconfig
config CONFIG_SHELL_CMD
	bool
	default y

config CONFIG_SHELL_CMD_DISPLAY
	bool "display cmd"

config CONFIG_SHELL_CMD_FLASH
	bool "flash cmd"

config CONFIG_SHELL_CMD_CD
	bool "cd cmd"

config CONFIG_SHELL_CMD_CONFIG
	bool "config cmd"

config CONFIG_SHELL_CMD_GO
	bool "go cmd"

config CONFIG_SHELL_CMD_HELP
	bool "help cmd"

config CONFIG_SHELL_CMD_MEM
	bool "mem cmd"

config CONFIG_SHELL_CMD_SHELL
	bool "shell cmd"

config CONFIG_SHELL_CMD_TFTP
	bool "tftp cmd"

config CONFIG_SHELL_CMD_UART
	bool "uart cmd"
```
